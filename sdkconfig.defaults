## sdkconfig.defaults
```kconfig
CONFIG_AUTOSTART_ARDUINO=y
CONFIG_FREERTOS_HZ=1000
CONFIG_BOOTLOADER_APP_ROLLBACK_ENABLE=y

CONFIG_ESP32_DEFAULT_CPU_FREQ_160=n
CONFIG_ESP32_DEFAULT_CPU_FREQ_240=y
CONFIG_ESP32_DEFAULT_CPU_FREQ_MHZ=240

CONFIG_FREERTOS_TIMER_TASK_PRIORITY=20
CONFIG_FREERTOS_TIMER_TASK_STACK_DEPTH=8192

#
# Bluetooth
#
CONFIG_BT_ENABLED=y

CONFIG_BTDM_CTRL_MODE_BTDM=y
CONFIG_BTDM_CTRL_BR_EDR_MAX_ACL_CONN=2
CONFIG_BTDM_CTRL_BR_EDR_MAX_SYNC_CONN=0
CONFIG_BTDM_CTRL_BR_EDR_SCO_DATA_PATH_PCM=y
CONFIG_BTDM_CTRL_BR_EDR_SCO_DATA_PATH_EFF=1
CONFIG_BTDM_CTRL_PCM_ROLE_EDGE_CONFIG=y
CONFIG_BTDM_CTRL_PCM_ROLE_MASTER=y
CONFIG_BTDM_CTRL_PCM_POLAR_FALLING_EDGE=y
CONFIG_BTDM_CTRL_PCM_ROLE_EFF=0
CONFIG_BTDM_CTRL_PCM_POLAR_EFF=0
CONFIG_BTDM_CTRL_LEGACY_AUTH_VENDOR_EVT=y
CONFIG_BTDM_CTRL_LEGACY_AUTH_VENDOR_EVT_EFF=y
CONFIG_BTDM_CTRL_BR_EDR_MAX_ACL_CONN_EFF=2
CONFIG_BTDM_CTRL_BR_EDR_MAX_SYNC_CONN_EFF=0
CONFIG_BTDM_CTRL_PINNED_TO_CORE_0=y
CONFIG_BTDM_CTRL_PINNED_TO_CORE=0
CONFIG_BTDM_CTRL_HCI_MODE_VHCI=y

#
# MODEM SLEEP Options
#
#CONFIG_BTDM_CTRL_MODEM_SLEEP=y
#CONFIG_BTDM_CTRL_MODEM_SLEEP_MODE_ORIG=y
## CONFIG_BTDM_CTRL_MODEM_SLEEP_MODE_EVED is not set
#CONFIG_BTDM_CTRL_LPCLK_SEL_MAIN_XTAL=y
## end of MODEM SLEEP Options
#
#CONFIG_BTDM_SCAN_DUPL_TYPE_DEVICE=y
## CONFIG_BTDM_SCAN_DUPL_TYPE_DATA is not set
## CONFIG_BTDM_SCAN_DUPL_TYPE_DATA_DEVICE is not set
#CONFIG_BTDM_SCAN_DUPL_TYPE=0
#CONFIG_BTDM_SCAN_DUPL_CACHE_SIZE=20
#CONFIG_BTDM_MESH_DUPL_SCAN_CACHE_SIZE=100
#CONFIG_BTDM_CTRL_FULL_SCAN_SUPPORTED=y
#CONFIG_BTDM_RESERVE_DRAM=0xdb5c
#CONFIG_BTDM_CTRL_HLI=y


#
# Bluedroid Options
#
CONFIG_BT_BLUEDROID_ENABLED=y
CONFIG_BT_SPP_ENABLED=y
CONFIG_BT_BTC_TASK_STACK_SIZE=8192
CONFIG_BT_BLUEDROID_PINNED_TO_CORE_0=y
# CONFIG_BT_BLUEDROID_PINNED_TO_CORE_1 is not set
CONFIG_BT_BLUEDROID_PINNED_TO_CORE=0
CONFIG_BT_BTU_TASK_STACK_SIZE=8192
# CONFIG_BT_BLUEDROID_MEM_DEBUG is not set
CONFIG_BT_CLASSIC_ENABLED=y
CONFIG_BT_A2DP_ENABLE=y
CONFIG_BT_HFP_ENABLE=y
CONFIG_BT_HFP_CLIENT_ENABLE=y
# CONFIG_BT_HFP_AG_ENABLE is not set
CONFIG_BT_HFP_AUDIO_DATA_PATH_PCM=y
# CONFIG_BT_HFP_AUDIO_DATA_PATH_HCI is not set
# CONFIG_BT_HID_ENABLED is not set
CONFIG_BT_SSP_ENABLED=y
CONFIG_BT_GATTS_ENABLE=y
# CONFIG_BT_GATTS_PPCP_CHAR_GAP is not set
CONFIG_BT_GATT_MAX_SR_PROFILES=8
# CONFIG_BT_GATTS_SEND_SERVICE_CHANGE_MANUAL is not set
CONFIG_BT_GATTS_SEND_SERVICE_CHANGE_AUTO=y
CONFIG_BT_GATTS_SEND_SERVICE_CHANGE_MODE=0
CONFIG_BT_GATTC_ENABLE=y
# CONFIG_BT_GATTC_CACHE_NVS_FLASH is not set
CONFIG_BT_GATTC_CONNECT_RETRY_COUNT=3
# CONFIG_BT_SMP_SLAVE_CON_PARAMS_UPD_ENABLE is not set
CONFIG_BT_STACK_NO_LOG=y
CONFIG_BT_ACL_CONNECTIONS=4
CONFIG_BT_MULTI_CONNECTION_ENBALE=y
# CONFIG_BT_ALLOCATION_FROM_SPIRAM_FIRST is not set
CONFIG_BT_SMP_ENABLE=y
CONFIG_BT_MAX_DEVICE_NAME_LEN=32
```
